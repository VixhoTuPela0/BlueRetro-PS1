## main/Kconfig.projbuild
```kconfig
menu "BlueRetro"

    config BLUERETRO_HW2
        bool "Enable support for HW2 features"
        default y
        help
            Select this to enable HW2 features like port detection.

    choice
        prompt "Select universal or specific system"
        default BLUERETRO_SYSTEM_PSX_PS2
        help
            BlueRetro is an universal adapter but you may force it to support
            only one system.

        config BLUERETRO_SYSTEM_PSX_PS2
            bool "PSX/PS2"
            help
                Select this to support only PSX & PS2.

    endchoice

    menu "Debug"

        config BLUERETRO_QEMU
            bool "Enable QEMU friendly config"
            help
                Select this to make an image for QEMU.

        config BLUERETRO_WS_CMDS
            bool "Enable websocket cmds"
            help
                Select this to enable websocket cmds.

        config BLUERETRO_BT_DISABLE
            bool "Disable Bluetooth init"
            help
                Select this to disable Bluetooth init.

        config BLUERETRO_BT_H4_TRACE
            bool "Enable Bluetooth H4 tracing"
            help
                Select this to enable Bluetooth H4 tracing.

        config BLUERETRO_BT_SSP_DBG
            bool "Enable Bluetooth SSP debug mode"
            help
                Select this to enable Bluetooth SSP debug mode.

        config BLUERETRO_GENERIC_HID_DEBUG
            bool "Enable Generic HID report debug"
            help
                Select this to enable Generic HID report debug.

        config BLUERETRO_DUMP_HID_DESC
            bool "Enable HID descriptor dump"
            help
                Select this to dump HID descriptor.

        config BLUERETRO_TEST_FALLBACK_REPORT
            bool "Enable testing fallback report"
            help
                Select this to test fallback report.

        config BLUERETRO_RAW_REPORT_DUMP
            bool "Enable RAW report dump"
            help
                Select this to dump RAW report data.

        config BLUERETRO_ADAPTER_BTNS_DBG
            bool "Enable adapter buttons debug"
            help
                Select this to enable adapter buttons debug.

        config BLUERETRO_ADAPTER_RUMBLE_DBG
            bool "Enable adapter rumble debug"
            help
                Select this to enable adapter rumble debug.

        config BLUERETRO_ADAPTER_RUMBLE_TEST
            bool "Enable adapter rumble test"
            help
                Select this to enable adapter rumble test.

        config BLUERETRO_ADAPTER_INPUT_DBG
            bool "Enable adapter input debug"
            help
                Select this to enable adapter input debug.

        config BLUERETRO_ADAPTER_INPUT_MAP_DBG
            bool "Enable adapter input mapping debug"
            help
                Select this to enable adapter input mapping debug.

        config BLUERETRO_WIRED_TRACE
            bool "Enable wired trace"
            help
                Select this to enable wired trace.

        config BLUERETRO_BT_TIMING_TESTS
            bool "Enable Bluetooth timing tests"
            help
                Select this to enable Bluetooth timeing tests.

        config BLUERETRO_BT_REPORT_INTERVAL_STATS
            bool "Print interval between receive Bluetooth HID report"
            depends on BLUERETRO_BT_TIMING_TESTS
            help
                Print interval between receive Bluetooth HID report.

        choice
            prompt "Enable Bluetooth minimum latency test on GPIO26"
            depends on BLUERETRO_BT_TIMING_TESTS
            optional
            help
                Select to enable Bluetooth minimum latency test.

            config BLUERETRO_BT_MIN_LATENCY_TEST_PS3
                bool "PS3"

            config BLUERETRO_BT_MIN_LATENCY_TEST_PS4
                bool "PS4"

            config BLUERETRO_BT_MIN_LATENCY_TEST_PS5
                bool "PS5"

            config BLUERETRO_BT_MIN_LATENCY_TEST_WIIU
                bool "WIIU"

            config BLUERETRO_BT_MIN_LATENCY_TEST_XB1
                bool "XB1"

            config BLUERETRO_BT_MIN_LATENCY_TEST_SW
                bool "SW"

        endchoice

        config BLUERETRO_BTMON_VERBOSE
            bool "Enable verbose loggin into BT monitor"
            help
                Seclect this to enable verbose loggin into BT monitor.

        config BLUERETRO_COVERAGE
            bool "Enable gcov coverage logging"
            help
                Seclect this to enable gcov coverage logging.

    endmenu

endmenu
```
