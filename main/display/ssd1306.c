/*
 * Copyright (c) 2024, BlueRetro
 * SPDX-License-Identifier: Apache-2.0
 */

#include <string.h>
#include <stdio.h>
#include <freertos/FreeRTOS.h>
#include <freertos/task.h>
#include "driver/i2c.h"
#include "driver/gpio.h"
#include "display/ssd1306.h"

/* ------------------------------------------------------------------ */
/*  I2C transport                                                       */
/* ------------------------------------------------------------------ */

#define OLED_I2C_PORT   I2C_NUM_0
#define OLED_FREQ_HZ    400000
#define OLED_CMD_BYTE   0x00  /* Co=0, D/C#=0 */
#define OLED_DATA_BYTE  0x40  /* Co=0, D/C#=1 */

/* framebuffer: 8 pages × 128 columns */
static uint8_t fb[OLED_PAGES][OLED_WIDTH];

/* ------------------------------------------------------------------ */
/*  SSD1306 command list (128×64, charge-pump, horizontal addressing)  */
/* ------------------------------------------------------------------ */
static const uint8_t init_cmds[] = {
    0xAE,       /* display off */
    0xD5, 0x80, /* set display clock divide ratio / oscillator freq */
    0xA8, 0x3F, /* set multiplex ratio (63 → 64 rows) */
    0xD3, 0x00, /* set display offset */
    0x40,       /* set display start line = 0 */
    0x8D, 0x14, /* charge pump: enable */
    0x20, 0x00, /* memory addressing mode: horizontal */
    0xA1,       /* segment remap (col 127 → SEG0) */
    0xC8,       /* COM output scan direction: remapped */
    0xDA, 0x12, /* COM pins hardware configuration */
    0x81, 0xCF, /* set contrast */
    0xD9, 0xF1, /* set pre-charge period */
    0xDB, 0x40, /* set VCOMH deselect level */
    0xA4,       /* entire display on (resume from RAM) */
    0xA6,       /* normal display (not inversed) */
    0xAF,       /* display on */
};

/* ------------------------------------------------------------------ */
/*  Low-level helpers                                                   */
/* ------------------------------------------------------------------ */

static esp_err_t i2c_write(uint8_t ctrl, const uint8_t *data, size_t len)
{
    i2c_cmd_handle_t cmd = i2c_cmd_link_create();
    i2c_master_start(cmd);
    i2c_master_write_byte(cmd, (OLED_I2C_ADDR << 1) | I2C_MASTER_WRITE, true);
    i2c_master_write_byte(cmd, ctrl, true);
    if (data && len) {
        i2c_master_write(cmd, (uint8_t *)data, len, true);
    }
    i2c_master_stop(cmd);
    esp_err_t ret = i2c_master_cmd_begin(OLED_I2C_PORT, cmd, pdMS_TO_TICKS(50));
    i2c_cmd_link_delete(cmd);
    return ret;
}

static inline esp_err_t send_cmd(uint8_t c)
{
    return i2c_write(OLED_CMD_BYTE, &c, 1);
}

static inline esp_err_t send_cmds(const uint8_t *buf, size_t len)
{
    return i2c_write(OLED_CMD_BYTE, buf, len);
}

/* ------------------------------------------------------------------ */
/*  Public API                                                          */
/* ------------------------------------------------------------------ */

int ssd1306_init(void)
{
    esp_err_t ret;

    /* Optional hardware reset */
#if OLED_RST_PIN >= 0
    gpio_config_t rst_conf = {
        .pin_bit_mask = 1ULL << OLED_RST_PIN,
        .mode = GPIO_MODE_OUTPUT,
        .pull_up_en = GPIO_PULLUP_DISABLE,
        .pull_down_en = GPIO_PULLDOWN_DISABLE,
        .intr_type = GPIO_INTR_DISABLE,
    };
    gpio_config(&rst_conf);
    gpio_set_level(OLED_RST_PIN, 0);
    vTaskDelay(pdMS_TO_TICKS(10));
    gpio_set_level(OLED_RST_PIN, 1);
    vTaskDelay(pdMS_TO_TICKS(10));
#endif

    /* Configure I2C master */
    i2c_config_t conf = {
        .mode = I2C_MODE_MASTER,
        .sda_io_num = OLED_SDA_PIN,
        .scl_io_num = OLED_SCL_PIN,
        .sda_pullup_en = GPIO_PULLUP_ENABLE,
        .scl_pullup_en = GPIO_PULLUP_ENABLE,
        .master.clk_speed = OLED_FREQ_HZ,
    };
    ret = i2c_param_config(OLED_I2C_PORT, &conf);
    if (ret != ESP_OK) {
        printf("# ssd1306: i2c_param_config failed: %d\n", ret);
        return -1;
    }
    ret = i2c_driver_install(OLED_I2C_PORT, I2C_MODE_MASTER, 0, 0, 0);
    if (ret != ESP_OK) {
        printf("# ssd1306: i2c_driver_install failed: %d\n", ret);
        return -1;
    }

    vTaskDelay(pdMS_TO_TICKS(5));

    /* Send initialisation sequence */
    ret = send_cmds(init_cmds, sizeof(init_cmds));
    if (ret != ESP_OK) {
        printf("# ssd1306: init cmds failed: %d\n", ret);
        return -1;
    }

    ssd1306_clear();
    ssd1306_update();
    return 0;
}

void ssd1306_clear(void)
{
    memset(fb, 0, sizeof(fb));
}

void ssd1306_update(void)
{
    /* Set column and page address to cover the whole display */
    uint8_t addr_cmds[] = {
        0x21, 0x00, 0x7F, /* column address: 0–127 */
        0x22, 0x00, 0x07, /* page address:   0–7   */
    };
    send_cmds(addr_cmds, sizeof(addr_cmds));

    /* Send all pages row-by-row using the DATA control byte.
     * We split into page-sized chunks so each I2C transaction stays
     * within the driver's internal buffer limits.                     */
    for (int page = 0; page < OLED_PAGES; page++) {
        i2c_cmd_handle_t cmd = i2c_cmd_link_create();
        i2c_master_start(cmd);
        i2c_master_write_byte(cmd, (OLED_I2C_ADDR << 1) | I2C_MASTER_WRITE, true);
        i2c_master_write_byte(cmd, OLED_DATA_BYTE, true);
        i2c_master_write(cmd, fb[page], OLED_WIDTH, true);
        i2c_master_stop(cmd);
        i2c_master_cmd_begin(OLED_I2C_PORT, cmd, pdMS_TO_TICKS(100));
        i2c_cmd_link_delete(cmd);
    }
}

void ssd1306_draw_pixel(uint8_t x, uint8_t y, uint8_t on)
{
    if (x >= OLED_WIDTH || y >= OLED_HEIGHT) {
        return;
    }
    uint8_t page = y / 8;
    uint8_t bit  = y % 8;
    if (on) {
        fb[page][x] |= (uint8_t)(1 << bit);
    } else {
        fb[page][x] &= (uint8_t)~(1 << bit);
    }
}

/* ------------------------------------------------------------------ */
/*  Minimal 5×8 ASCII font (columns, LSB = top pixel)                  */
/*  Characters 0x20 (space) through 0x7E (~)                           */
/* ------------------------------------------------------------------ */
static const uint8_t font5x8[][5] = {
    {0x00,0x00,0x00,0x00,0x00}, /* 0x20   */
    {0x00,0x00,0x5F,0x00,0x00}, /* 0x21 ! */
    {0x00,0x07,0x00,0x07,0x00}, /* 0x22 " */
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    {0x10,0x08,0x08,0x10,0x08}, /* 0x7E ~ */
};

void ssd1306_draw_char(uint8_t x, uint8_t y, char c)
{
    if ((uint8_t)c < 0x20 || (uint8_t)c > 0x7E) {
        return;
    }
    const uint8_t *glyph = font5x8[(uint8_t)c - 0x20];
    for (int col = 0; col < 5; col++) {
        uint8_t col_data = glyph[col];
        for (int row = 0; row < 8; row++) {
            ssd1306_draw_pixel((uint8_t)(x + col), (uint8_t)(y + row),
                               (col_data >> row) & 1);
        }
    }
}

uint8_t ssd1306_draw_string(uint8_t x, uint8_t y, const char *str, uint8_t max_w)
{
    uint8_t cx = x;
    while (*str) {
        if (cx + 6 > x + max_w) {
            break;
        }
        ssd1306_draw_char(cx, y, *str);
        cx += 6;
        str++;
    }
    return cx;
}

void ssd1306_draw_bitmap(uint8_t x, uint8_t y,
                          const uint8_t *bmp, uint8_t w, uint8_t h)
{
    /* bytes per row in the source bitmap */
    uint8_t row_bytes = (w + 7) / 8;
    for (int row = 0; row < h; row++) {
        for (int col = 0; col < w; col++) {
            int byte_idx = row * row_bytes + col / 8;
            int bit_idx  = 7 - (col % 8);   /* MSB = leftmost */
            uint8_t on   = (bmp[byte_idx] >> bit_idx) & 1;
            ssd1306_draw_pixel((uint8_t)(x + col), (uint8_t)(y + row), on);
        }
    }
}
